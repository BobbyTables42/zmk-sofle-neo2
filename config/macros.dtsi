

/ { 
    macros {
        win_desktop_right: win_desktop_right {
            compatible = "zmk,behavior-macro";
            #binding-cells = <0>;
            bindings =
                <&macro_press>,
                <&kp LCTRL>,
                <&macro_press>,
                <&kp LGUI>,
                <&macro_tap>,
                <&kp RIGHT>,
                <&macro_release>,
                <&kp LGUI>,
                <&macro_release>,
                <&kp LCTRL>;
        };

        win_desktop_left: win_desktop_left {
            compatible = "zmk,behavior-macro";
            #binding-cells = <0>;
            bindings =
                <&macro_press>,
                <&kp LCTRL>,
                <&macro_press>,
                <&kp LGUI>,
                <&macro_tap>,
                <&kp LEFT>,
                <&macro_release>,
                <&kp LGUI>,
                <&macro_release>,
                <&kp LCTRL>;
        };
    };

};
